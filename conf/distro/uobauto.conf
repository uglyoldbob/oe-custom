## meta-random/conf/machine/xjrad.conf
```bitbake
#@TYPE: Machine
#@NAME: xjrad

#@DESCRIPTION: Machine configuration for custom xj radio

KERNEL_ARGS ?= "console=ttyS0,115200 console=tty0 fbcon=map:0 net.ifnames=0"
KERNEL_ROOTSPEC ?= "root=/dev/mmcblk0p${distro_bootpart} rw rootwait"
IMAGE_ROOTFS_ALIGNMENT ?= "1024"

NVPMODEL ?= "nvpmodel_t210_jetson-nano"

TEGRA_BOARDID ?= "3448"
TEGRA_FAB ?= "400"
TEGRA_BOARDSKU ?= "0003"
TEGRA_BUPGEN_SPECS ?= "fab=400"

require conf/machine/include/tegra210.inc

MACHINE_EXTRA_RRECOMMENDS += "kernel-module-rtl8821cu"

EMMC_SIZE ?= ""
EMMC_DEVSECT_SIZE ?= "512"
BOOTPART_SIZE ?= ""
BOOTPART_LIMIT ?= "10485760"
ROOTFSPART_SIZE ?= "15032385536"
ODMDATA ?= "0x94000"
EMMC_BCT ?= "P3448_A00_lpddr4_204Mhz_P987.cfg"
NVIDIA_BOARD ?= "t210ref"
NVIDIA_PRODUCT ?= "p3541-0000"
NVIDIA_BOARD_CFG ?= ""
PARTITION_LAYOUT_TEMPLATE ?= "flash_l4t_t210_spi_sd_p3448.xml"
TEGRA_SPIFLASH_BOOT ?= "1"
TEGRAFLASH_SDCARD_SIZE ?= "16G"
OTABOOTDEV ?= "/dev/mtdblock0"
OTAGPTDEV ?= "/dev/mtdblock0"

KERNEL_DEVICETREE = "uglyoldbob/xjrad.dtb"
INITRAMFS_IMAGE = ""
INITRAMFS_IMAGE_BUNDLE = "1"

unset PREFERRED_PROVIDER_virtual/dtb
PREFERRED_PROVIDER_virtual/kernel = "linux-xjrad"
PREFERRED_PROVIDER_virtual/bootloader = "u-boot"
UBOOT_CONFIG ??= "sd"
UBOOT_CONFIG[sd] = "xjrad_config,sdcard"
UBOOT_CONFIG[mmc] = "xjrad_config,mmc"
UBOOT_EXTLINUX_ROOT = "root=/dev/mmcblkp2"

DTB_EXTRA_DEPS = ""
EXTERNAL_KERNEL_DEVICETREE = ""

MACHINE_ESSENTIAL_EXTRA_RDEPENDS = "u-boot u-boot-script kernel-devicetree kernel-modules \
	linux-firmware-nvidia-gpu linux-firmware-nvidia-tegra linux-firmware-rtl8168 libdrm i2c-tools media-ctl \
	libglx-nvidia "
MACHINE_ESSENTIAL_EXTRA_RRECOMMENDS = "vulkan-tools vulkan-headers vulkan-volk vulkan-utility-libraries"
MACHINE_EXTRA_RDEPENDS = "networkmanager networkmanager-nmcli vulkan-loader"
MACHINE_EXTRA_RRECOMMENDS = ""

MACHINE_FEATURES = "alsa bluetooth pci phone rtc serial touchscreen usbhost vfat"

SERIAL_CONSOLES = "115200;ttyS0"

INIT_MANAGER = "systemd"
VIRTUAL-RUNTIME_base-utils = "packagegroup-core-base-utils"
PREFERRED_PROVIDER_virtual/egl = "mesa"
PREFERRED_PROVIDER_virtual/libgles1 = "mesa"
PREFERRED_PROVIDER_virtual/libgles2 = "mesa"
PREFERRED_PROVIDER_virtual/libgles3 = "mesa"
PREFERRED_PROVIDER_virtual/libgl = "mesa"
PREFERRED_PROVIDER_virtual/libgbm = "mesa"
```

## meta-random/scripts/lib/wic/canned-wks/altera-deca.wks
```
part /boot --source bootimg-partition --ondisk mmcblk0 --fstype=vfat --label boot --active --align 4 --fixed-size 16
part / --source rootfs --ondisk mmcblk2 --fstype=ext4 --label root --align 4
```

## meta-random/scripts/lib/wic/canned-wks/pxe-image.wks
```
part /boot --source bootimg-pcbios --ondisk sda --label boot --active --align 1024
part / --source rootfs --ondisk sda --fstype=ext2 --label root --align 8192 --size 4G
bootloader --ptable msdos
```

## meta-random/scripts/lib/wic/canned-wks/sdimage-cyclone.wks
```
# short-description: Create SD card image for cyclone V soc
# long-description: Creates a partitioned SD card image for a cyclone V soc.

#--system-id=0xa2
part --source rawcopy --sourceparams="file=custom.img" --ondisk mmcblk0 --align 64 --size 16

part /bootpart --source bootimg-partition --ondisk mmcblk0 --fstype=vfat --label boot --active --align 64 --size 16

part / --source rootfs --ondisk mmcblk0 --fstype=ext4 --label root --align 8192 --size 1024
```

## meta-random/scripts/lib/wic/canned-wks/xbox-cd.wks
```
# short-description: Create a hybrid ISO image
# long-description: Creates an EFI and legacy bootable hybrid ISO image
# which can be used on optical media as well as USB media.

part /boot --source iso --sourceparams="loader=grub-efi,image_name=xbox-cd" --ondisk cd --label XBOXCD

bootloader  --timeout=15  --append=""
```

## meta-random/scripts/lib/wic/canned-wks/xbox-hd.wks
```
#part /bootpart --source bootimg-partition --ondisk sda --fstype=vfat --label boot --active --align 64 --size 16


part / --source rootfs --ondisk sda --fstype=ext2 --label root --align 8192 --size 4G
bootloader --ptable msdos
```

## meta-variscite/conf/layer.conf
```bitbake
# We have a conf directory, append to BBPATH
BBPATH .= ":${LAYERDIR}"

# We have a recipes-* directory, add to BBFILES
BBFILES += "${LAYERDIR}/*/*/*.bb \
            ${LAYERDIR}/*/*/*.bbappend \
            ${LAYERDIR}/*/*.bb \
            ${LAYERDIR}/*/*.bbappend"

BBFILE_COLLECTIONS += "uglyoldbob-variscite"
BBFILE_PATTERN_uglyoldbob-variscite = "^${LAYERDIR}/"
BBFILE_PRIORITY_uglyoldbob-variscite = "8"

LAYERSERIES_COMPAT_uglyoldbob-variscite = "scarthgap"

LAYERDEPENDS_uglyoldbob-variscite = "clang-layer swupdate"
```

## meta-variscite/conf/machine/xjrad.conf
```bitbake
MACHINEOVERRIDES =. "imx8mp-var-dart:mx8mp:imx-generic-bsp:imx-nxp-bsp:imxdrm:imxvpu:imxgpu:imxgpu2d:imxgpu3d:imxvulkan:mx8-generic-bsp:mx8-nxp-bsp:mx8m-generic-bsp:mx8m-nxp-bsp:mx8mp-generic-bsp:mx8mp-nxp-bsp:"

require conf/machine/include/imx-base.inc
require conf/machine/include/arm/armv8a/tune-cortexa53.inc

require variscite.inc

require conf/machine/imx8mp-var-dart.conf

PREFERRED_PROVIDER_u-boot ?= "u-boot-variscite"
PREFERRED_PROVIDER_u-boot-fw-utils ?= "u-boot-fw-utils"
PREFERRED_PROVIDER_virtual/bootloader ?= "u-boot-variscite"

OVERLAYFS_ETC_MOUNT_POINT = "/data"
OVERLAYFS_ETC_DEVICE = "/dev/mmcblk2p3"
OVERLAYFS_ETC_FSTYPE ?= "ext4"
OVERLAYFS_ETC_MOUNT_OPTIONS = "sync"
OVERLAYFS_ETC_EXPOSE_LOWER = "true"

OVERLAYFS_MOUNT_POINT[homessh] = "/data"
OVERLAYFS_MOUNT_POINT[bluetooth] = "/data/bluetooth"
```

## scripts/lib/wic/canned-wks/auto-radio.wks
```
bootloader --ptable msdos
part / --source rootfs --ondisk mmcblk0 --fstype=ext4 --label root --align 4 --mkfs-extraopts "-O ^orphan_file"
```
