## conf/distro/uobauto.conf
```bitbake
DISTRO = "uobauto"
DISTRO_NAME = "UobAuto"
DISTRO_VERSION = "0.0.1"
DISTRO_CODENAME = "scarthgap"
SDK_VENDOR = "-uobautosdk"
SDK_VERSION = "${@d.getVar('DISTRO_VERSION').replace('snapshot-${METADATA_REVISION}', 'snapshot')}"
SDK_VERSION[vardepvalue] = "${SDK_VERSION}"

MAINTAINER = "Thomas Epperson<thomas.epperson@gmail.com>"

TARGET_VENDOR = "-uobauto"

LOCALCONF_VERSION = "2"

# Override these in poky based distros
POKY_DEFAULT_EXTRA_RDEPENDS = "packagegroup-core-boot"
POKY_DEFAULT_EXTRA_RRECOMMENDS = "kernel-module-af-packet"

DISTRO_FEATURES = "acl alsa bluetooth ext2 ipv4 ipv6 pcmcia usbgadget usbhost wifi xattr nfs zeroconf pci 3g nfc vfat seccomp opengl multiarch wayland vulkan pam systemd usrmerge pulseaudio gobject-introspection-data ldconfig"

DISTRO_FEATURES:remove:riscv32 = "seccomp"

PREFERRED_VERSION_linux-yocto ?= "6.12%"
PREFERRED_VERSION_linux-yocto-rt ?= "6.12%"

SDK_NAME = "${DISTRO}-${TCLIBC}-${SDKMACHINE}-${IMAGE_BASENAME}-${TUNE_PKGARCH}-${MACHINE}"
SDKPATHINSTALL = "/opt/${DISTRO}/${SDK_VERSION}"

DISTRO_EXTRA_RDEPENDS += "${POKY_DEFAULT_EXTRA_RDEPENDS} ssh-key"
DISTRO_EXTRA_RRECOMMENDS += "${POKY_DEFAULT_EXTRA_RRECOMMENDS}"

PACKAGE_CLASSES ?= "package_rpm"

SANITY_TESTED_DISTROS ?= " \
            poky-4.3 \n \
            poky-5.0 \n \
            ubuntu-20.04 \n \
            ubuntu-22.04 \n \
            ubuntu-23.04 \n \
            fedora-38 \n \
            fedora-39 \n \
            centosstream-8 \n \
            debian-11 \n \
            debian-12 \n \
            opensuseleap-15.4 \n \
            almalinux-8.8 \n \
            almalinux-9.2 \n \
            rocky-9 \n \
            "
# add poky sanity bbclass
INHERIT += "poky-sanity"

# QA check settings - a little stricter than the OE-Core defaults
# (none currently necessary as we now match OE-Core)
#WARN_TO_ERROR_QA = "X"
#WARN_QA_remove = "${WARN_TO_ERROR_QA}"
#ERROR_QA_append = " ${WARN_TO_ERROR_QA}"

require conf/distro/include/poky-world-exclude.inc
require conf/distro/include/no-static-libs.inc
require conf/distro/include/yocto-uninative.inc
require conf/distro/include/security_flags.inc
INHERIT += "uninative"

BB_SIGNATURE_HANDLER ?= "OEEquivHash"
BB_HASHSERVE ??= "auto"

POKY_INIT_MANAGER = "systemd"
INIT_MANAGER ?= "${POKY_INIT_MANAGER}"

# We need debug symbols so that SPDX license manifests for the kernel work
KERNEL_EXTRA_FEATURES:append = " features/debug/debug-kernel.scc"

# Enable creation of SPDX manifests by default
INHERIT += "create-spdx"
```

## conf/layer.conf
```bitbake
# We have a conf directory, append to BBPATH
BBPATH .= ":${LAYERDIR}"

# We have a recipes-* directory, add to BBFILES
BBFILES += "${LAYERDIR}/*/*/*.bb \
            ${LAYERDIR}/*/*/*.bbappend \
            ${LAYERDIR}/*/*.bb \
            ${LAYERDIR}/*/*.bbappend"

BBFILE_COLLECTIONS += "uglyoldbob"
BBFILE_PATTERN_uglyoldbob = "^${LAYERDIR}/"
BBFILE_PRIORITY_uglyoldbob = "8"

LAYERSERIES_COMPAT_uglyoldbob = "walnascar"

LAYERDEPENDS_uglyoldbob = "clang-layer swupdate"
```

## conf/machine/altera-deca.conf
```bitbake
#@TYPE: Machine
#@NAME: altera-deca
#@DESCRIPTION: Machine configuration for altera deca board

DEFAULTTUNE = "riscv32"

require conf/machine/include/riscv/tune-riscv.inc

PREFERRED_PROVIDER_virtual/kernel = "linux-altera-deca"
KERNEL_IMAGETYPE = "Image"

EXTRA_IMAGEDEPENDS += "litex-core"

INIT_MANAGER = "systemd"
VIRTUAL-RUNTIME_base-utils = "packagegroup-core-base-utils"
```

## conf/machine/pc-64.conf
```bitbake
#@TYPE: Machine
#@NAME: Generic x86_64
#@DESCRIPTION: Machine configuration for generic x86_64 (64-bit) PCs and servers. Supports a moderately wide range of drivers that should boot and be usable on "typical" hardware.

DEFAULTTUNE ?= "core2-64"
require conf/machine/include/x86/tune-core2.inc
require conf/machine/include/genericx86-common.inc

MACHINE_FEATURES:append = " efi"

MACHINE_EXTRA_RDEPENDS += " rtl8821ce "

#For runqemu
QB_SYSTEM_NAME = "qemu-system-x86_64"

OVERLAYFS_ETC_MOUNT_POINT = "/data"
OVERLAYFS_ETC_DEVICE = "/dev/sda4"
OVERLAYFS_ETC_FSTYPE ?= "ext4"
OVERLAYFS_ETC_MOUNT_OPTIONS = "sync"
OVERLAYFS_ETC_EXPOSE_LOWER = "true"

OVERLAYFS_MOUNT_POINT[homessh] = "/data"
OVERLAYFS_MOUNT_POINT[bluetooth] = "/data/bluetooth"
```

## conf/machine/tang-nano-20k.conf
```bitbake
#@TYPE: Machine
#@NAME: altera-deca
#@DESCRIPTION: Machine configuration for altera deca board

DEFAULTTUNE = "riscv32"

require conf/machine/include/riscv/tune-riscv.inc

KERNEL_IMAGETYPE = "Image"

EXTRA_IMAGEDEPENDS += "litex-core-tang-nano-20k"

INIT_MANAGER = "systemd"
VIRTUAL-RUNTIME_base-utils = "packagegroup-core-base-utils"

WKS_FILE = "tang-nano-20k.wks"

UBOOT_MACHINE = "vexriscv-nes_config"

IMAGE_BOOT_FILES ?= "${KERNEL_IMAGETYPE}"
```

## conf/machine/uob-pcie1.conf
```bitbake
#@TYPE: Machine
#@NAME: altera-deca
#@DESCRIPTION: Machine configuration for altera deca board

DEFAULTTUNE = "riscv32"

require conf/machine/include/riscv/tune-riscv.inc

PREFERRED_PROVIDER_virtual/kernel = "linux-vexriscv32"
KERNEL_IMAGETYPE = "Image"

EXTRA_IMAGEDEPENDS += "litex-core"

INIT_MANAGER = "systemd"
VIRTUAL-RUNTIME_base-utils = "packagegroup-core-base-utils"

WKS_FILE = "uob-pcie1.wks"

IMAGE_BOOT_FILES ?= "${KERNEL_IMAGETYPE}"

LITEX_CORE_DEPENDS = "custom-litex-boards-native \
    litex-pythondata-cpu-vexriscv-native \
    litex-sdcard-native \
    radiant-native"

LITEX_BOARD = "uob_litex_boards/targets/sipeed_tang_nano_20k.py"
LITEX_COMPILE_PREPARE = "lattice_radiant_prepare_run"
LITEX_BOARD_ARGS = "--cpu-type vexriscv --cpu-variant lite \
    --uart-baudrate=115200 \
    --bios-console=full \
    --with-video-terminal \
    --with-sdcard \ 
    --with-rgb-led"
LITEX_RESULT = "sipeed_tang_nano_20k/gateware/sipeed_tang_nano_20k.fs"
```

## conf/machine/xjrad-old.conf
```bitbake
#@TYPE: Machine
#@NAME: xjrad

#@DESCRIPTION: Machine configuration for custom xj radio

MACHINEOVERRIDES =. "xjrad:jetson-nano-devkit:"

require conf/machine/jetson-nano-devkit.conf

PREFERRED_VERSION_weston = "10.0.2"
PREFERRED_VERSION_libweston = "10.0.2"
PREFERRED_PROVIDER_virtual/kernel = "linux-tegra"
KERNEL_DEVICETREE = "nvidia/xjrad.dtb"

OLDEST_KERNEL = "4.9"

MACHINE_FEATURES += "bluetooth"

MACHINE_EXTRA_RDEPENDS = "tegra-firmware-tegra210-xusb \
	linux-firmware-nvidia-gpu linux-firmware-nvidia-tegra \
	linux-firmware-rtl-nic \
	kernel-modules libglvnd networkmanager networkmanager-nmcli"

INITRAMFS_IMAGE = ""

KERNEL_ROOTSPEC = "root=mmcblk0p1"
KERNEL_ARGS = "console=ttyS0,115200 fbcon=map:0 net.ifnames=0 rootwait"
```

## meta-generic/conf/layer.conf
```bitbake
# We have a conf directory, append to BBPATH
BBPATH .= ":${LAYERDIR}"

# We have a recipes-* directory, add to BBFILES
BBFILES += "${LAYERDIR}/*/*/*.bb \
            ${LAYERDIR}/*/*/*.bbappend \
            ${LAYERDIR}/*/*.bb \
            ${LAYERDIR}/*/*.bbappend"

BBFILE_COLLECTIONS += "uglyoldbob-generic"
BBFILE_PATTERN_uglyoldbob-generic = "^${LAYERDIR}/"
BBFILE_PRIORITY_uglyoldbob-generic = "8"

LAYERSERIES_COMPAT_uglyoldbob-generic = "scarthgap walnascar"

LAYERDEPENDS_uglyoldbob-generic = "clang-layer swupdate"
```

## meta-random/conf/machine/altera-deca.conf
```bitbake
#@TYPE: Machine
#@NAME: altera-deca
#@DESCRIPTION: Machine configuration for altera deca board

DEFAULTTUNE = "riscv32"

require conf/machine/include/riscv/tune-riscv.inc

PREFERRED_PROVIDER_virtual/kernel = "linux-altera-deca"
KERNEL_IMAGETYPE = "Image"

EXTRA_IMAGEDEPENDS += "litex-core-altera-deca"

INIT_MANAGER = "systemd"
VIRTUAL-RUNTIME_base-utils = "packagegroup-core-base-utils"

WKS_FILE = "altera-deca.wks"

IMAGE_BOOT_FILES ?= "${KERNEL_IMAGETYPE}"

LITEX_CORE_DEPENDS = "custom-litex-boards-native \
    litex-oldsystems-native \
    litex-pythondata-cpu-vexriscv-native \
    litex-sdcard-native \
    litex-brianhg-ddr3-native \
    litex-uber-ddr3-native \
    quartus-native"

LITEX_BOARD = "litex_boards/targets/terasic_deca.py"
LITEX_COMPILE_PREPARE = ""
LITEX_BOARD_ARGS = "--cpu-type vexriscv --cpu-variant minimal --sys-clk-freq 50e6 \
   --uart-baudrate=115200 \
   --bios-console=full \
   --with-dram "
LITEX_RESULT = "terasic_deca/gateware/terasic_deca.sof terasic_deca/gateware/terasic_deca.pof"
```

## meta-random/conf/machine/de0nano.conf
```bitbake
#@TYPE: Machine
#@NAME: terasic DE0 nano development board with cyclone V soc
#@DESCRIPTION: Machine configuration for the terasic DE0 nano development board

DEFAULTTUNE ?= "cortexa9-neon"
include conf/machine/include/tune-cortexa9.inc

# Specify kernel recipe
#PREFERRED_PROVIDER_virtual/kernel ?= "linux-gumstix"
PREFERRED_PROVIDER_virtual/kernel ?= "linux-cyclone"

# Specify xserver components for builds including X11
PREFERRED_PROVIDER_virtual/xserver = "xserver-xorg"
XSERVER ?= "xserver-xorg \
            xf86-input-evdev \
            xf86-input-keyboard \
            xf86-input-mouse \
            xf86-video-fbdev "

# Default to external video, uncomment for LCD panels
GUI_MACHINE_CLASS = "smallscreen"
#GUI_MACHINE_CLASS ?= "bigscreen"

# For kernels older than 2.6.37, use "115200 ttyS2" instead
SERIAL_CONSOLES = "115200;ttyO2"

# tar.bz2 for SD card, UBI for nand
IMAGE_FSTYPES ?= "wic"

# The magic numbers:
# 512 MiB flash = 4096 PEBs (physical erase blocks) (PEB = 128 KiB sector)
# Manufacturer's spec is minimum 4016 PEBs are good for lifetime
# Logical erase block is PEB minus 2 KiB (NAND page size) for metadata
# Partitions reserve 4+14+2+64 PEBS for xloader/u-boot/env/linux
# Minimum remaining available for rootfs: 3932 PEBs (likewise 3932 LEBs)
MKUBIFS_ARGS = "-F -m 2048 -e 126KiB -c 3932"
UBINIZE_ARGS = "-m 2048 -p 128KiB -s 512"

UBI_VOLNAME = "rootfs"

# Ship all kernel modules by default
MACHINE_EXTRA_RRECOMMENDS = " kernel-modules"

#MACHINE_FEATURES = "alsa bluetooth ext2 keyboard serial touchscreen usbgadget usbhost vfat wifi"
MACHINE_FEATURES = "alsa ext2 keyboard serial touchscreen usbhost vfat"

# WIC configs for 2GB SD-Card
WKS_FILE ?= "sdimage-cyclone.wks"
IMAGE_BOOT_FILES = "zImage socfpga.dtb fpga.rbf"
do_image_wic[depends] += "mtools-native:do_populate_sysroot dosfstools-native:do_populate_sysroot"

UBOOT_MACHINE = "socfpga_de0_nano_soc_config"
UBOOT_BINARY = "u-boot-dtb.img"
SPL_BINARY = "u-boot-with-spl.sfp"
```

## meta-random/conf/machine/epia5000.conf
```bitbake
#@TYPE: Machine
#@NAME: epia-5000

#@DESCRIPTION: Machine configuration for epia5000 systems

PREFERRED_PROVIDER_virtual/kernel ?= "linux-yocto"

require conf/machine/include/x86/tune-c3.inc

XSERVER ?= "${XSERVER_X86_BASE} \
           ${XSERVER_X86_EXT} \
           ${XSERVER_X86_VESA} \
           "

MACHINE_FEATURES += "x86 pci"

MACHINE_EXTRA_RRECOMMENDS += "linux-firmware v86d "

EXTRA_OECONF:append_pn-matchbox-panel-2 = " --with-battery=acpi"

APPEND += "video=vesafb vga=0x318"

LINUX_KERNEL_TYPE = "tiny"
KERNEL_IMAGETYPE = "bzImage"
```

## meta-random/conf/machine/include/tune-xbox.inc
```bitbake
DEFAULTTUNE ?= "xbox"

TUNE_ARCH = "i386"
TUNE_PKGARCH = "xbox"

# Extra tune features
TUNEVALID[xbox] = "Enable xbox specific processor optimizations"
TUNE_CCARGS .= "${@bb.utils.contains('TUNE_FEATURES', 'xbox', ' -march=pentium', '', d)}"
TUNE_CCARGS .= " -Wa,--divide"

# Extra tune selections
AVAILTUNES += "xbox"
TUNE_FEATURES_tune-xbox = "xbox"
BASE_LIB_tune-xbox = "lib"
TUNE_PKGARCH_tune-xbox = "xbox"
#PACKAGE_EXTRA_ARCHS_tune-xbox = "${PACKAGE_EXTRA_ARCHS_tune-x86} xbox"
```

## meta-random/conf/machine/numato-mimas-a7.conf
```bitbake
#@TYPE: Machine
#@NAME: numata mimas a7
#@DESCRIPTION: Machine configuration for numata mimas a7 board

DEFAULTTUNE = "riscv32"

require conf/machine/include/riscv/tune-riscv.inc

PREFERRED_PROVIDER_virtual/kernel = "linux-vexriscv32"
KERNEL_IMAGETYPE = "Image"

EXTRA_IMAGEDEPENDS += "litex-core"

INIT_MANAGER = "systemd"
VIRTUAL-RUNTIME_base-utils = "packagegroup-core-base-utils"

WKS_FILE = "uob-pcie1.wks"

IMAGE_BOOT_FILES ?= "${KERNEL_IMAGETYPE}"

LITEX_CORE_DEPENDS = "custom-litex-boards-native \
    litex-pythondata-cpu-vexriscv-native \
    litex-sdcard-native \
    vivado-native"

LITEX_BOARD = "litex_boards/targets/numato_mimas_a7.py"
LITEX_COMPILE_PREPARE = "vivado_prepare_run"
LITEX_BOARD_ARGS = "--cpu-type vexriscv --cpu-variant lite \
    --uart-baudrate=115200 \
    --bios-console=full"
LITEX_RESULT = "numato_mimas_a7/gateware/numato_mimas_a7.bit"
```

## meta-random/conf/machine/tang-nano-20k.conf
```bitbake
#@TYPE: Machine
#@NAME: altera-deca
#@DESCRIPTION: Machine configuration for altera deca board

DEFAULTTUNE = "riscv32"

require conf/machine/include/riscv/tune-riscv.inc

KERNEL_IMAGETYPE = "Image"

EXTRA_IMAGEDEPENDS += "litex-core"

INIT_MANAGER = "systemd"
VIRTUAL-RUNTIME_base-utils = "packagegroup-core-base-utils"

WKS_FILE = "tang-nano-20k.wks"

UBOOT_MACHINE = "vexriscv-nes_config"

IMAGE_BOOT_FILES ?= "${KERNEL_IMAGETYPE}"

LITEX_CORE_DEPENDS = "custom-litex-boards-native \
    litex-oldsystems-native \
    litex-pythondata-cpu-vexriscv-native \
    litex-sdcard-native \
    gowin-native"

LITEX_BOARD = "uob_litex_boards/targets/sipeed_tang_nano_20k.py"
LITEX_COMPILE_PREPARE = ""
LITEX_BOARD_ARGS = "--cpu-type vexriscv --cpu-variant lite \
    --uart-baudrate=115200 \
    --bios-console=full \
    --with-video-terminal \
    --with-sdcard \ 
    --with-rgb-led"
LITEX_RESULT = "sipeed_tang_nano_20k/gateware/sipeed_tang_nano_20k.fs"
```

## meta-random/conf/machine/xbox.conf
```bitbake
#@TYPE: Machine
#@NAME: xbox

#@DESCRIPTION: Machine configuration for xbox systems

PREFERRED_PROVIDER_virtual/kernel ?= "linux-xbox"


require conf/machine/include/x86/tune-i586.inc



XSERVER ?= "${XSERVER_X86_BASE} \
           ${XSERVER_X86_EXT} \
           ${XSERVER_X86_VESA} \
           "

MACHINE_EXTRA_RRECOMMENDS += "linux-firmware v86d "

EXTRA_OECONF:append_pn-matchbox-panel-2 = " --with-battery=acpi"

APPEND += "video=vesafb vga=0x318"

UBOOT_MACHINE = "microsoft-xbox_config"

LINUX_KERNEL_TYPE = "tiny"
KMACHINE:xbox = "xbox"
KERNEL_IMAGETYPE = "bzImage"

IMAGE_BOOT_FILES = "linuxboot.cfg"
```
