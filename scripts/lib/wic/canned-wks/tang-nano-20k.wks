## scripts/lib/wic/canned-wks/tang-nano-20k.wks
```
part /boot --source bootimg-partition --fstype=vfat --label boot --active --align 4 --fixed-size 16
part / --source rootfs --fstype=ext4 --label root --align 4
```
